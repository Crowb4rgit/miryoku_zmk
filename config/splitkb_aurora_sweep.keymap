// Copyright 2022 Manna Harbour
// https://github.com/manna-harbour/miryoku

&led_strip {
    chain-length = <21>;
};

#include "../miryoku/custom_config.h"
#include "../miryoku/mapping/34/ferris.h"
#include "../miryoku/miryoku.dtsi"
